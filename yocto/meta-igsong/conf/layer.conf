## yocto/meta-igsong/conf/layer.conf
```bitbake
# We have a conf and classes directory, add to BBPATH
BBPATH .= ":${LAYERDIR}"

# We have a recipes directory containing .bb and .bbappend files, add to BBFILES
BBFILES += "${LAYERDIR}/recipes-*/*/*.bb \
			${LAYERDIR}/recipes-*/*/*.bbappend"

BBFILE_COLLECTIONS += "igsong"
BBFILE_PATTERN_igsong = "^${LAYERDIR}/"
BBFILE_PRIORITY_igsong = "9"

# This should only be incremented on significant changes that will
# cause compatibility issues with other layers
LAYERVERSION_igsong = "2"
LAYERDEPENDS_igsong = "core"

RM_WORK_EXCLUDE += ""
```
